## prj.conf
```kconfig
#
#    Copyright (c) 2021-2024 Project CHIP Authors
#
#    Licensed under the Apache License, Version 2.0 (the "License");
#    you may not use this file except in compliance with the License.
#    You may obtain a copy of the License at
#
#        http://www.apache.org/licenses/LICENSE-2.0
#
#    Unless required by applicable law or agreed to in writing, software
#    distributed under the License is distributed on an "AS IS" BASIS,
#    WITHOUT WARRANTIES OR CONDITIONS OF ANY KIND, either express or implied.
#    See the License for the specific language governing permissions and
#    limitations under the License.
#

# This sample uses Kconfig.defaults to set options common for all
# samples. This file should contain only options specific for this sample
# or overrides of default values.

# Enable CHIP
CONFIG_CHIP=y
CONFIG_STD_CPP17=y

# 32773 == 0x8005 (example lighting-app)
CONFIG_CHIP_DEVICE_PRODUCT_ID=32773

# Bluetooth Low Energy configuration
CONFIG_BT_DEVICE_NAME="TelinkLight"

# Disable Matter OTA DFU
CONFIG_CHIP_OTA_REQUESTOR=n
CONFIG_CHIP_DFU_OVER_BT_SMP=n
CONFIG_CHIP_DFU_OVER_BT_SMP_BUILD=n
CONFIG_CHIP_DEVICE_SOFTWARE_VERSION=1
# CONFIG_CHIP_DEVICE_SERIAL_NUMBER="TelinkLight"
CONFIG_TELINK_OTA_BUTTON_TEST=n

# Disable CHIP shell support
CONFIG_CHIP_LIB_SHELL=n

# Disable factory data support
CONFIG_CHIP_FACTORY_DATA=n
CONFIG_CHIP_FACTORY_DATA_BUILD=n
CONFIG_CHIP_FACTORY_DATA_MERGE_WITH_FIRMWARE=n
CONFIG_CHIP_CERTIFICATION_DECLARATION_STORAGE=n

# open seucre programming , need to open CONFIG_CHIP_FACTORY_DATA and CONFIG_CHIP_CERTIFICATION_DECLARATION_STORAGE
# init should be n
CONFIG_SECURE_PROGRAMMING=n

# Enable PWM
CONFIG_PWM=y
CONFIG_CHIP_DEVICE_DISCRIMINATOR=0xF00
# Enable Power Management
CONFIG_PM=n

# Enable Independent Button
CONFIG_CHIP_BUTTON_MANAGER_IRQ_MODE=n

# Enable CHIP-ID via ble
CONFIG_EXPOSE_CHIP_ID_VIA_BLE=n

# Enable Deferred Store Attribute
CONFIG_DEFERRED_ATTR_STORAGE=n

# CONFIG_MCUBOOT_SIGNATURE_KEY_FILE="bootloader/mcuboot/ecdsa_private_key.pem"
```

## boards/tl3238x.conf
```kconfig
# CONFIG_CHIP_DEVICE_SERIAL_NUMBER="TelinkLight-tl3238x"

# Disable Matter OTA DFU
CONFIG_CHIP_OTA_REQUESTOR=n

CONFIG_CHIP_DFU_OVER_BT_SMP=n
CONFIG_CHIP_DFU_OVER_BT_SMP_BUILD=n

# LZMA compression library support
# Keep LZMA library enabled for potential general compression needs
CONFIG_LZMA=n
# Disable Telink-specific LZMA firmware decompression for bootloader
CONFIG_COMPRESS_LZMA=n

# Enable ADC
CONFIG_ADC=y

# matter switch mode 
# config NORMAL_MODE    0 independent matter mode
# ACTION_DUAL_MODE      1 matter action switch mode ,such as by button, light-switch-app
# AUTO_SWITCH_DUAL_MODE 2 matter auto-switch mode ,such as lighting-app by scan QR code.should use 4m flash
CONFIG_DUAL_MODE=0
```

## src/ZclCallbacks.cpp
```c
/*
 *
 *    Copyright (c) 2022-2024 Project CHIP Authors
 *    All rights reserved.
 *
 *    Licensed under the Apache License, Version 2.0 (the "License");
 *    you may not use this file except in compliance with the License.
 *    You may obtain a copy of the License at
 *
 *        http://www.apache.org/licenses/LICENSE-2.0
 *
 *    Unless required by applicable law or agreed to in writing, software
 *    distributed under the License is distributed on an "AS IS" BASIS,
 *    WITHOUT WARRANTIES OR CONDITIONS OF ANY KIND, either express or implied.
 *    See the License for the specific language governing permissions and
 *    limitations under the License.
 */

#include "AppTask.h"
#include "ColorFormat.h"

#include <app-common/zap-generated/attributes/Accessors.h>
#include <app-common/zap-generated/ids/Attributes.h>
#include <app-common/zap-generated/ids/Clusters.h>
#include <app/ConcreteAttributePath.h>
#include <lib/support/logging/CHIPLogging.h>

LOG_MODULE_DECLARE(app, CONFIG_CHIP_APP_LOG_LEVEL);

using namespace chip;
using namespace chip::app::Clusters;

void MatterPostAttributeChangeCallback(const chip::app::ConcreteAttributePath & attributePath, uint8_t type, uint16_t size,
                                       uint8_t * value)
{
    static HsvColor_t hsv;
    static XyColor_t xy;
    ClusterId clusterId     = attributePath.mClusterId;
    AttributeId attributeId = attributePath.mAttributeId;

    if (clusterId == OnOff::Id && attributeId == OnOff::Attributes::OnOff::Id)
    {
        ChipLogDetail(Zcl, "Cluster OnOff: attribute OnOff set to %u", *value);
        GetAppTask().SetInitiateAction(*value ? AppTask::ON_ACTION : AppTask::OFF_ACTION,
                                       static_cast<int32_t>(AppEvent::kEventType_DeviceAction), value);
    }
    else if (clusterId == LevelControl::Id && attributeId == LevelControl::Attributes::CurrentLevel::Id)
    {
        if (GetAppTask().IsTurnedOn())
        {
            ChipLogDetail(Zcl, "Cluster LevelControl: attribute CurrentLevel set to %u", *value);
            GetAppTask().SetInitiateAction(AppTask::LEVEL_ACTION, static_cast<int32_t>(AppEvent::kEventType_DeviceAction), value);
        }
        else
        {
            ChipLogDetail(Zcl, "LED is off. Try to use move-to-level-with-on-off instead of move-to-level");
        }
    }
    else if (clusterId == ColorControl::Id)
    {
        /* Ignore several attributes that are currently not processed */
        if ((attributeId == ColorControl::Attributes::RemainingTime::Id) ||
            (attributeId == ColorControl::Attributes::EnhancedColorMode::Id) ||
            (attributeId == ColorControl::Attributes::ColorMode::Id))
        {
            return;
        }

        /* XY color space */
        if (attributeId == ColorControl::Attributes::CurrentX::Id || attributeId == ColorControl::Attributes::CurrentY::Id)
        {
            if (attributeId == ColorControl::Attributes::CurrentX::Id)
            {
                xy.x = *reinterpret_cast<uint16_t *>(value);
            }
            else if (attributeId == ColorControl::Attributes::CurrentY::Id)
            {
                xy.y = *reinterpret_cast<uint16_t *>(value);
            }

            ChipLogDetail(Zcl, "New XY color: %u|%u", xy.x, xy.y);
            GetAppTask().SetInitiateAction(AppTask::COLOR_ACTION_XY, static_cast<int32_t>(AppEvent::kEventType_DeviceAction),
                                           (uint8_t *) &xy);
        }
        /* HSV color space */
        else if (attributeId == ColorControl::Attributes::CurrentHue::Id ||
                 attributeId == ColorControl::Attributes::CurrentSaturation::Id ||
                 attributeId == ColorControl::Attributes::EnhancedCurrentHue::Id)
        {
            if (attributeId == ColorControl::Attributes::EnhancedCurrentHue::Id)
            {
                hsv.h = (uint8_t) (((*reinterpret_cast<uint16_t *>(value)) & 0xFF00) >> 8);
                hsv.s = (uint8_t) ((*reinterpret_cast<uint16_t *>(value)) & 0xFF);
            }
            else if (attributeId == ColorControl::Attributes::CurrentHue::Id)
            {
                hsv.h = *value;
            }
            else if (attributeId == ColorControl::Attributes::CurrentSaturation::Id)
            {
                hsv.s = *value;
            }
            ChipLogDetail(Zcl, "New HSV color: hue = %u| saturation = %u", hsv.h, hsv.s);
            GetAppTask().SetInitiateAction(AppTask::COLOR_ACTION_HSV, static_cast<int32_t>(AppEvent::kEventType_DeviceAction),
                                           (uint8_t *) &hsv);
        }
        /* Temperature Mireds color space */
        else if (attributeId == ColorControl::Attributes::ColorTemperatureMireds::Id)
        {
            ChipLogDetail(Zcl, "New Temperature Mireds color = %u", *(uint16_t *) value);
            GetAppTask().SetInitiateAction(AppTask::COLOR_ACTION_CT, static_cast<int32_t>(AppEvent::kEventType_DeviceAction),
                                           value);
        }
        else if (attributePath.mClusterId == DeltadelfinAnimationGradient::Id)
        {
            switch (attributePath.mAttributeId)
            {
        case DeltadelfinAnimationGradient::Attributes::CurrentAnimation::Id:
            if (size == sizeof(uint8_t))
            {
                uint8_t animation = *value;
                ChipLogProgress(Zcl, "*** App CurrentAnimation changed: %u", animation);
            }
            break;
        case DeltadelfinAnimationGradient::Attributes::CurrentGradient::Id:
            if (size == sizeof(uint8_t))
            {
                uint8_t gradient = *value;
                ChipLogProgress(Zcl, "*** App CurrentGradient changed: %u", gradient);
            }
            break;
        case DeltadelfinAnimationGradient::Attributes::DisplayMode::Id:
            if (size == sizeof(uint8_t))
            {
                uint8_t mode = *value;
                ChipLogProgress(Zcl, "*** App DisplayMode changed: %u", mode);
            }
            break;
        default:
            break;
            }
        }
        else
        {
            ChipLogDetail(Zcl, "Ignore ColorControl attribute (%u) that is not currently processed!", attributeId);
        }
    }
}
```
